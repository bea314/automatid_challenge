## main/Kconfig.projbuild
```kconfig
menu "AUTOMATID CHALLENGE WIFI CONFIGURATION"

    config ESP_WIFI_SSID
        string "WiFi SSID"
        default "myssid"
        help
            SSID (network name) for the example to connect to.

    config ESP_WIFI_PASSWORD
        string "WiFi Password"
        default "mypassword"
        help
            WiFi password (WPA or WPA2) for the example to use.
        

endmenu

menu "AUTOMATID CHALLENGE AWS IOT CORE CONFIGURATION"

    config MQTT_CLIENT_IDENTIFIER
        string "Set the `MQTT Client Identifier` to the thing name"
        default "testClient"
        help
            Each client identifier must be unique, so edit as required to ensure that 
            no two clients connecting to the same broker use the same client identifier.
            The Thing Name should match a Thing that you created while following the 
            Getting Started guide. To check the Things you have registered, go to the 
            AWS IoT console web interface, click Registry and then click Things.

    config MQTT_BROKER_ENDPOINT
        string "Endpoint of the MQTT broker to connect to"
        default "test.mosquitto.org"
        help
            This can be run with any MQTT broker, that supports server authentication.
            Your AWS IoT account has a unique endpoint hostname to connect to. To find it, 
            open the AWS IoT Console and click the "Settings" button on the bottom left side. 
            The endpoint hostname is shown under the "Custom Endpoint" heading on this page.
    
    config MQTT_BROKER_PORT
        int "Port of the MQTT broker use"
        default 8883
        help
            In general, port 8883 is for secured MQTT connections.
            Port 443 requires use of the ALPN TLS extension with the ALPN protocol name.
            When using port 8883, ALPN is not required.

    config HARDWARE_PLATFORM_NAME
        string "The hardware platform"
        default "ESP32"
        help
            The name of the hardware platform the application is running on.

    config MQTT_NETWORK_BUFFER_SIZE
        int "Size of the network buffer for MQTT packets"
        range 1024 2048
        default 1024
        help
            Size of the network buffer for MQTT packets.

    choice EXAMPLE_CHOOSE_PKI_ACCESS_METHOD
        prompt "Choose PKI credentials access method"
        default EXAMPLE_USE_PLAIN_FLASH_STORAGE
        help
            ESP devices support multiple ways to secure store the PKI credentials.
            Currently Secure Element (ATECC608A) and DS peripheral
            (using ESP Secure Cert Manager) are supported.
            The default behaviour is to access the PKI credentials which are embedded in the binary.
            Consult the ESP-TLS documentation in ESP-IDF Programming guide for more details.

        config EXAMPLE_USE_SECURE_ELEMENT
        bool "Use secure element (ATECC608A)"
        depends on (IDF_TARGET_ESP32 || IDF_TARGET_ESP32C2) && ESP_TLS_USING_MBEDTLS
        # To confirm that we are satisfying the dependencies of secure element
        select ESP_TLS_USE_SECURE_ELEMENT
        help
            Enable the use of secure element for the example.
            The esp-cryptoauthlib component is required for enabling
            this option.

        config EXAMPLE_USE_ESP_SECURE_CERT_MGR
        bool "Use ESP Secure Certificate Manager"
        help
            Enable the use of ESP Secure Certificate Manager APIs for the example.
            Please refer to ESP Secure Certificate Manager documentation for more details.

        config EXAMPLE_USE_PLAIN_FLASH_STORAGE
        bool "Use flash storage (default)"
        help
            This option expects the Private key and Device certificate to be embedded in the binary.
            This is the default behaviour.
    endchoice

endmenu
```
